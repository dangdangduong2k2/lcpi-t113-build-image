## Config.in
```kconfig
menu "LCPI packages"

source "$BR2_EXTERNAL_LCPI_T113_PATH/package/lvgl/Config.in"
source "$BR2_EXTERNAL_LCPI_T113_PATH/package/lcpi-lvgl-test/Config.in"

endmenu
```

## configs/lcpi_t113_defconfig
```kconfig
BR2_arm=y
BR2_cortex_a7=y
BR2_ARM_FPU_VFPV4=y
BR2_PACKAGE_HOST_LINUX_HEADERS_CUSTOM_6_18=y
BR2_GLOBAL_PATCH_DIR="$(BR2_EXTERNAL_LCPI_T113_PATH)/board/lctech/lcpi-t113/patches"
BR2_DOWNLOAD_FORCE_CHECK_HASHES=y
BR2_TARGET_GENERIC_HOSTNAME="lcpi-t113"
BR2_TARGET_GENERIC_ISSUE="LCPI-PC-T113 Buildroot bring-up"
BR2_TARGET_GENERIC_GETTY_PORT="ttyS3"
BR2_ROOTFS_OVERLAY="$(BR2_EXTERNAL_LCPI_T113_PATH)/board/lctech/lcpi-t113/rootfs_overlay"
BR2_ROOTFS_POST_IMAGE_SCRIPT="support/scripts/genimage.sh"
BR2_ROOTFS_POST_SCRIPT_ARGS="-c $(BR2_EXTERNAL_LCPI_T113_PATH)/board/lctech/lcpi-t113/genimage.cfg"
BR2_LINUX_KERNEL=y
BR2_LINUX_KERNEL_CUSTOM_VERSION=y
BR2_LINUX_KERNEL_CUSTOM_VERSION_VALUE="6.18.8"
BR2_LINUX_KERNEL_DEFCONFIG="sunxi"
BR2_LINUX_KERNEL_CONFIG_FRAGMENT_FILES="$(BR2_EXTERNAL_LCPI_T113_PATH)/board/lctech/lcpi-t113/linux.fragment"
BR2_LINUX_KERNEL_DTS_SUPPORT=y
BR2_LINUX_KERNEL_CUSTOM_DTS_DIR="$(BR2_EXTERNAL_LCPI_T113_PATH)/board/lctech/lcpi-t113/linux-dts"
BR2_LINUX_KERNEL_INSTALL_TARGET=y
BR2_LINUX_KERNEL_NEEDS_HOST_OPENSSL=y
BR2_PACKAGE_FB_TEST_APP=y
BR2_PACKAGE_FBSET=y
BR2_PACKAGE_LIBDRM=y
BR2_PACKAGE_LVGL=y
BR2_PACKAGE_LCPI_LVGL_TEST=y
BR2_TARGET_ROOTFS_EXT2=y
BR2_TARGET_ROOTFS_EXT2_4=y
BR2_TARGET_ROOTFS_EXT2_SIZE="256M"
# BR2_TARGET_ROOTFS_TAR is not set
BR2_TARGET_UBOOT=y
BR2_TARGET_UBOOT_BUILD_SYSTEM_KCONFIG=y
BR2_TARGET_UBOOT_CUSTOM_VERSION=y
BR2_TARGET_UBOOT_CUSTOM_VERSION_VALUE="2026.01"
BR2_TARGET_UBOOT_BOARD_DEFCONFIG="mangopi_mq_r"
BR2_TARGET_UBOOT_CONFIG_FRAGMENT_FILES="$(BR2_EXTERNAL_LCPI_T113_PATH)/board/lctech/lcpi-t113/uboot/uart3.fragment"
BR2_TARGET_UBOOT_CUSTOM_DTS_PATH="$(BR2_EXTERNAL_LCPI_T113_PATH)/board/lctech/lcpi-t113/uboot/sun8i-t113s-mangopi-mq-r-t113-u-boot.dtsi"
BR2_TARGET_UBOOT_NEEDS_DTC=y
BR2_TARGET_UBOOT_NEEDS_PYLIBFDT=y
BR2_TARGET_UBOOT_NEEDS_OPENSSL=y
BR2_TARGET_UBOOT_NEEDS_GNUTLS=y
BR2_TARGET_UBOOT_SPL=y
BR2_TARGET_UBOOT_SPL_NAME="u-boot-sunxi-with-spl.bin"
BR2_PACKAGE_HOST_GENIMAGE=y
```

## package/lcpi-lvgl-test/Config.in
```kconfig
config BR2_PACKAGE_LCPI_LVGL_TEST
	bool "LCPI LCD and GT911 LVGL self-test"
	select BR2_PACKAGE_LVGL
	help
	  Automatically starts a framebuffer display and Goodix GT911 touch
	  diagnostic on boot. No serial console or interactive command is needed.
```

## package/lvgl/Config.in
```kconfig
config BR2_PACKAGE_LVGL
	bool "LVGL graphics library"
	help
	  LVGL 9.x built for the LCPI framebuffer and evdev test application.
	  This external package is intentionally built as C-only, avoiding a
	  C++ toolchain dependency for the bring-up image.
```
